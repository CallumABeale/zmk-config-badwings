## boards/shields/badwings/Kconfig.defconfig
```kconfig
if SHIELD_BADWINGS_LEFT

config ZMK_KEYBOARD_NAME
    default "BadWings"

config ZMK_SPLIT_ROLE_CENTRAL
    default y

endif

if SHIELD_BADWINGS_LEFT || SHIELD_BADWINGS_RIGHT

config ZMK_SPLIT
    default y

endif
```

## config/boards/shields/badwings/Kconfig.shield
```kconfig
config SHIELD_BADWINGS_LEFT
    def_bool $(shields_list_contains,badwings_left)

config SHIELD_BADWINGS_RIGHT
    def_bool $(shields_list_contains,badwings_right)
```

#include "badwings.dtsi"

&default_transform {
    col-offset = <5>;
};

&kscan0 {
    col-gpios = <
        &pro_micro 8 GPIO_ACTIVE_HIGH
        &pro_micro 9 GPIO_ACTIVE_HIGH
        &pro_micro 21 GPIO_ACTIVE_HIGH
        &pro_micro 20 GPIO_ACTIVE_HIGH
        &pro_micro 19 GPIO_ACTIVE_HIGH
    >;
};

right_encoder: encoder_right {
    compatible = "alps,ec11";
    a-gpios = <&pro_micro 7 (GPIO_ACTIVE_HIGH | GPIO_PULL_UP)>;
    b-gpios = <&pro_micro 6 (GPIO_ACTIVE_HIGH | GPIO_PULL_UP)>;
    steps = <80>;
};
